/*
 * Copyright (c) 2026
 * SPDX-License-Identifier: Apache-2.0
 *
 * GD32F103CBT6: 128 KiB flash, 20 KiB SRAM (medium-density).
 */

#include <mem.h>
#include <gd/gd32f10x/gd32f10x.dtsi>

&flash0 {
	reg = <0x08000000 DT_SIZE_K(128)>;
};

&sram0 {
	reg = <0x20000000 DT_SIZE_K(20)>;
};
