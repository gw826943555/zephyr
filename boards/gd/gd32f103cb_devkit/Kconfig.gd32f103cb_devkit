## boards/gd/gd32f103cb_devkit/Kconfig.gd32f103cb_devkit
```kconfig
# Copyright (c) 2026
# SPDX-License-Identifier: Apache-2.0

config BOARD_GD32F103CB_DEVKIT
	select SOC_GD32F103CB
```

## boards/gd/gd32f103cb_devkit/board.yml
```yaml
board:
  name: gd32f103cb_devkit
  full_name: GD32F103CB minimal devkit
  vendor: gd
  socs:
    - name: gd32f103cb
```

## drivers/i2c/Kconfig.gd32
```kconfig
# Copyright (c) 2021 BrainCo Inc.
# SPDX-License-Identifier: Apache-2.0

config I2C_GD32
	bool "GigaDevice GD32 I2C driver"
	default y
	depends on DT_HAS_GD_GD32_I2C_ENABLED
	select PINCTRL
	help
	  Enables GigaDevice GD32 I2C driver

config I2C_GD32_BUS_RECOVERY
	bool "GD32 I2C driver bus recovery support"
	default y if I2C_BUS_RECOVERY
	depends on I2C_GD32 && GPIO
	select I2C_BITBANG
	help
	  Enable GD32 I2C driver bus recovery support via GPIO bitbanging.
```

## drivers/usb/udc/Kconfig.gd32
```kconfig
# Copyright (c) 2026
# SPDX-License-Identifier: Apache-2.0

config UDC_GD32
	bool "GigaDevice GD32 USB device controller driver"
	default y
	depends on DT_HAS_GD_GD32_USBD_ENABLED
	select GPIO if $(dt_compat_any_has_prop,$(DT_COMPAT_GD_GD32_USBD),disconnect-gpios)
	help
	  Driver for the USB device controller of the GigaDevice GD32F10x
	  MCU series. The controller exposes a 512 byte dedicated packet RAM
	  accessed through a 16-bit buffer descriptor table.

if UDC_GD32

config UDC_GD32_STACK_SIZE
	int "GD32 USB device controller driver internal thread stack size"
	default 1024
	help
	  GD32 USB device controller driver internal thread stack size.

config UDC_GD32_THREAD_PRIORITY
	int "GD32 USB device controller driver thread priority"
	default 8
	help
	  GD32 USB device controller driver thread priority.

endif # UDC_GD32
```

## dts/bindings/i2c/gd,gd32-i2c.yaml
```yaml
# Copyright (c) 2021 BrainCo Inc.
# SPDX-License-Identifier: Apache-2.0

description: GigaDevice GD32 I2C

compatible: "gd,gd32-i2c"

include: [i2c-controller.yaml, reset-device.yaml, pinctrl-device.yaml]

properties:
  reg:
    required: true

  interrupts:
    required: true

  resets:
    required: true

  clocks:
    required: true

  pinctrl-0:
    required: true

  pinctrl-names:
    required: true

  scl-gpios:
    type: phandle-array
    description: |
      GPIO to which the I2C SCL signal is routed. This is only needed for
      I2C bus recovery support.

  sda-gpios:
    type: phandle-array
    description: |
      GPIO to which the I2C SDA signal is routed. This is only needed for
      I2C bus recovery support.
```

## dts/bindings/usb/gd,gd32-usbd.yaml
```yaml
# Copyright (c) 2026
# SPDX-License-Identifier: Apache-2.0

description: GigaDevice GD32F10x USB device controller

compatible: "gd,gd32-usbd"

include: [usb-ep.yaml, reset-device.yaml]

properties:
  reg:
    required: true

  interrupts:
    required: true

  ram-size:
    type: int
    required: true
    description: |
      Size of USB dedicated packet RAM.

  disconnect-gpios:
    type: phandle-array
    description: |
      Some boards use a USB DISCONNECT pin to enable
      the pull-up resistor on USB Data Positive signal.

  clocks:
    required: true

  resets:
    required: true
```

## soc/gd/gd32/gd32f10x/Kconfig
```kconfig
# Copyright (c) 2026
# SPDX-License-Identifier: Apache-2.0

config SOC_SERIES_GD32F10X
	select ARM
	select CPU_CORTEX_M3
	select CPU_CORTEX_M_HAS_SYSTICK
	select CPU_CORTEX_M_HAS_VTOR
	select GD32_HAS_AFIO_PINMUX
	select GD32_HAS_IRC_40K
	select SOC_EARLY_INIT_HOOK
```

## soc/gd/gd32/gd32f10x/Kconfig.defconfig.series
```kconfig
# Copyright (c) 2026
# SPDX-License-Identifier: Apache-2.0

if SOC_SERIES_GD32F10X

rsource "Kconfig.defconfig.gd32*"

endif # SOC_SERIES_GD32F10X
```

## soc/gd/gd32/gd32f10x/Kconfig.soc
```kconfig
# Copyright (c) 2026
# SPDX-License-Identifier: Apache-2.0

config SOC_SERIES_GD32F10X
	bool
	select SOC_FAMILY_GD_GD32
	help
	  Enable support for GigaDevice GD32F10X MCU series (Cortex-M3).

config SOC_SERIES
	default "gd32f10x" if SOC_SERIES_GD32F10X

config SOC_GD32F103CB
	bool
	select SOC_SERIES_GD32F10X

config SOC
	default "gd32f103cb" if SOC_GD32F103CB
```
