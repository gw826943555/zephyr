## boards/st/stm32h750xb_artpi/Kconfig.stm32h750xb_artpi
```kconfig
# Copyright (c) 2023 STMicroelectronics
# SPDX-License-Identifier: Apache-2.0

config BOARD_STM32H750XB_ARTPI
	select SOC_STM32H750XX
```
